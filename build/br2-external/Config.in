## build/br2-external/Config.in
```kconfig
source "$BR2_EXTERNAL_PROTEA_PATH/package/protea-core-cli/Config.in"
source "$BR2_EXTERNAL_PROTEA_PATH/package/protea-desktop/Config.in"
```

## build/br2-external/package/protea-core-cli/Config.in
```kconfig
config BR2_PACKAGE_PROTEA_CORE_CLI
    bool "protea-core-cli"
    depends on BR2_PACKAGE_HOST_RUSTC_TARGET_ARCH_SUPPORTS
    select BR2_PACKAGE_HOST_RUSTC
    help
      Protea shared-state command line service used by the base system.
```

## build/br2-external/package/protea-desktop/Config.in
```kconfig
config BR2_PACKAGE_PROTEA_DESKTOP
    bool "protea-desktop"
    depends on BR2_PACKAGE_HOST_RUSTC_TARGET_ARCH_SUPPORTS
    depends on BR2_PACKAGE_LIBGTK4
    depends on BR2_PACKAGE_LIBGTK4_WAYLAND
    select BR2_PACKAGE_HOST_RUSTC
    help
      Protea GTK4 desktop shell built from the repository source.
```
